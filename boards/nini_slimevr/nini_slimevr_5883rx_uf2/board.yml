## boards/nini_slimevr/nini_slimevr_5883rx_uf2/board.yml
```yaml
# Copyright (c) 2026
# SPDX-License-Identifier: Apache-2.0

board:
  name: nini_slimevr_5883rx_uf2
  full_name: NiNi_Unicorn & MINGYUE Smol SlimeVR 5883 Receiver
  vendor: nini_slimevr
  socs:
    - name: nrf52833
```

## boards/nini_slimevr_rx/board.yml
```yaml
# Copyright (c) 2026
# SPDX-License-Identifier: Apache-2.0

board:
  name: nini_slimevr_rx_uf2
  full_name: NiNi_Unicorn & MINGYUE Smol SlimeVR Receiver
  vendor: nini_slimevr
  socs:
    - name: nrf52833
```
